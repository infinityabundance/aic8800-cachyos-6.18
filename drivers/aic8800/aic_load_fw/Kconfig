## drivers/aic8800/aic_load_fw/Kconfig
```kconfig
config AIC_LOADFW_SUPPORT
	tristate "AIC8800 Firmware Loader Support"
	depends on AIC_WLAN_SUPPORT
	default m
	help
	  This option enables the firmware loading module required for 
	  AIC8800 Wi-Fi and Bluetooth initialization.

	  enables the command management and firmware loading 
	  logic defined in aicbluetooth_cmds.h/c.

	  enables the firmware loading module and the 
	  AICWFDBG diagnostic logging system.

	  enables the firmware loader and the high-performance 
	  RX pre-allocation memory system.

	  enables the firmware loading module. 
	  It includes high-performance RX buffer pre-allocation 
	  defined in aicwf_rx_prealloc.h.

	  firmware loader with TX/RX pre-allocation 
	  optimizations for better performance on Linux.

	  firmware loader with TX queue pre-allocation 
	  optimizations (aicwf_txq_prealloc.h).

	  USB-based firmware loader for AIC8800.
	  It handles device enumeration and power management.

	  USB-based firmware loader. 
	  It relies on the structures defined in aicwf_usb.h to 
	  manage communication with the hardware.

	  enables the firmware loader, including MD5-based 
	  integrity checking for firmware binaries.

	  If you are building this for CachyOS or standard Linux, say M here.
	  This will create the 'aic_load_fw.ko' module.
```

## pkg/aic8800-cachyos-dkms/usr/src/aic8800-cachyos-1.0.r137.gf9b7c0d/drivers/aic8800/Kconfig
```kconfig
config AIC_WLAN_SUPPORT
	bool "AIC wireless Support"
	default y
	help
	  This provides support for AIC8800 series wireless chips.
	  Selecting this will allow you to configure the loader and the FullMAC driver.

if AIC_WLAN_SUPPORT
# Use relative paths so it works from the root of your cloned repository
source "aic8800_fdrv/Kconfig"
source "aic_load_fw/Kconfig"
endif
```

## pkg/aic8800-cachyos-dkms/usr/src/aic8800-cachyos-1.0.r137.gf9b7c0d/drivers/aic8800/aic8800_fdrv/Kconfig
```kconfig
# drivers/aic8800/aic8800_fdrv/Kconfig

config AIC8800_WLAN_SUPPORT
	tristate "AIC8800 Wi-Fi 6 (802.11ax) Support"
	depends on MAC80211 && CFG80211 && USB
	select AIC_LOADFW_SUPPORT
	default m
	help
	  This is the main driver for AIC8800 series USB Wi-Fi chips.
	  It supports IEEE 802.11a/b/g/n/ac/ax (Wi-Fi 6) and 2.4GHz/5GHz 
	  dual-band operation.

	  To compile this driver as a module, choose M here: the module
	  will be called aic8800_fdrv.

if AIC8800_WLAN_SUPPORT

config AIC8800_HE_SUPPORT
	bool "Enable Wi-Fi 6 (802.11ax) High Efficiency"
	default y
	help
	  Enables High Efficiency (HE) features for 802.11ax. 
	  This is required to achieve Wi-Fi 6 speeds. Turn this off 
	  only if you encounter compatibility issues with specific 
	  access points.

config AIC_BR_SUPPORT
	bool "Enable Bridge Extension (NAT25) Support"
	default y
	help
	  Enable this if you intend to use the Wi-Fi interface as part 
	  of a Linux software bridge (e.g., for HostAPD hotspots or 
	  network repeaters). This enables the NAT25 L2-translation 
	  logic in aic_br_ext.c.

config AIC8800_FORCE_5G
	bool "Force enable 5GHz Band"
	default n
	help
	  Forces the driver to enable 5GHz channels regardless of 
	  initial regulatory domain data. Use this with caution.

endif # AIC8800_WLAN_SUPPORT
```
